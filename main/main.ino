#include <Arduino.h>
#include <Wire.h>
#include <ESP8266WiFi.h>
#include <ESP8266HTTPClient.h>
#include <ArduinoJson.h>
#include <Adafruit_GFX.h>
#include <Adafruit_SSD1306.h>
#include <time.h>
#include "secrets.h"
#include "Org_01.h"

// --- OLED ---
#define SCREEN_WIDTH 128
#define SCREEN_HEIGHT 64
#define OLED_RESET    -1
#define OLED_SDA D1
#define OLED_SCL D2
#define LED_PIN LED_BUILTIN
Adafruit_SSD1306 display(SCREEN_WIDTH, SCREEN_HEIGHT, &Wire, OLED_RESET);

// --- API ---
const char* apiURL = "https://pool.nerdminers.org/pool/pool.status";
String userApiURL = String("https://pool.nerdminers.org/users/") + WALLET_ADDR;

// --- Timers ---
unsigned long lastSwitch = 0;
const unsigned long pageInterval = 10000; // 10 seconds
int currentPage = 0;

// --- Stats ---
int usersCount = 0, workersCount = 0, idleCount = 0, disconnectedCount = 0;
String hashrate1m, hashrate5m, hashrate15m, hashrate1hr, hashrate6hr, hashrate1d, hashrate7d;
float diff = 0.0, accepted = 0, rejected = 0, bestshare = 0;
float SPS1m = 0, SPS5m = 0, SPS15m = 0, SPS1h = 0;

// --- User Stats ---
String u_hashrate1m, u_hashrate5m, u_hashrate1hr, u_hashrate1d, u_hashrate7d;
unsigned long u_lastshare = 0, u_authorised = 0;
int u_workers = 0;
float u_shares = 0.0, u_bestshare = 0.0, u_bestever = 0.0;

// --- String Splitter ---
String splitNumberUnit(String value) {
  int i = 0;
  while (i < value.length() && (isDigit(value[i]) || value[i] == '.')) {
    i++;
  }

  String number = value.substring(0, i);
  String unit = value.substring(i);

  if (unit.length() > 0) {
    return number + " " + unit;
  } else {
    return number;
  }
}

// --- Clock Page Animation ---
#define CLOCK_W 32
#define CLOCK_H 32
#define CLOCK_BYTES ((CLOCK_W * CLOCK_H) / 8)
#define CLOCK_FRAME_DELAY 42  // ms between frames, change if you want a faster/slower animation

const uint8_t PROGMEM frames_clock[][CLOCK_BYTES] = {
  {0,0,0,0,0,0,0,0,0,0,0,0,0,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0,0},
  {0,0,0,0,0,0,0,0,0,0,0,0,0,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0,0},
  {0,0,0,0,0,0,0,0,0,0,0,0,0,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0,0},
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  {0,0,0,0,0,0,0,0,0,0,0,0,0,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0,0}
};

const uint8_t CLOCK_FRAME_COUNT = sizeof(frames_clock) / sizeof(frames_clock[0]);

// --- Pool Stats Page Animation ---
#define POOL_W 32
#define POOL_H 32
#define POOL_BYTES ((POOL_W * POOL_H) / 8)
#define POOL_FRAME_DELAY 42

const uint8_t PROGMEM frames_pool[][POOL_BYTES] = {
  {60,0,62,0,102,0,103,0,194,0,65,0,131,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15,128},
  {60,0,62,0,102,0,103,0,194,0,65,0,131,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15,128},
  {60,0,62,0,102,0,103,0,194,0,65,0,131,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15,128},
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  {60,0,62,0,102,0,103,0,194,0,65,0,131,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15,128}
};

const uint8_t POOL_FRAME_COUNT = sizeof(frames_pool) / sizeof(frames_pool[0]);

// --- User Stats Page Animation ---
#define USER_W 32
#define USER_H 32
#define USER_BYTES ((USER_W * USER_H) / 8)
#define USER_FRAME_DELAY 42

const uint8_t PROGMEM frames_user[][USER_BYTES] = {
  {0,0,0,0,0,0,0,0,0,0,0,3,0,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0,0},
  {0,0,0,0,0,0,0,0,0,0,0,3,0,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0,0},
  {0,0,0,0,0,0,0,0,0,0,0,3,0,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0,0},
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  {0,0,0,0,0,0,0,0,0,0,0,3,0,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0,0}
};

const uint8_t USER_FRAME_COUNT = sizeof(frames_user) / sizeof(frames_user[0]);

// --- STARTUP ANIM (48x48) ---
#define STARTUP_W 48
#define STARTUP_H 48
#define STARTUP_FRAME_BYTES ((STARTUP_W * STARTUP_H) / 8) // = 288
#define STARTUP_FRAME_DELAY 42

const uint8_t PROGMEM frames_startup[][STARTUP_FRAME_BYTES] = {
  {0,0,0,0,0,0,0,0,0,0,0,0,0,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0,0},
  {0,0,0,0,0,0,0,0,0,0,0,0,0,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0,0},
  {0,0,0,0,0,0,0,0,0,0,0,0,0,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0,0},
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  {0,0,0,0,0,0,0,0,0,0,0,0,0,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0,0}
};

const uint8_t STARTUP_FRAME_COUNT = sizeof(frames_startup) / sizeof(frames_startup[0]);

// --- Animation control ---
unsigned long animLastMillis0 = 0;
uint8_t animFrameIdx0 = 0;
unsigned long startupLastMs = 0;
uint8_t startupFrameIdx = 0;

// --- Time setting function ---
void setupTime() {
  long offsetSeconds = UTC_OFFSET * 3600;
  long dstOffset = 0;

  configTime(offsetSeconds, 0, "pool.ntp.org", "time.nist.gov");
  unsigned long tstart = millis();
  // waiting until time() returns a reasonable value (e.g., > 1600000000) – adjust as needed
  time_t now;
  do {
    now = time(nullptr);
    drawStartupFrame(); // still animating the screen
    yield();
    delay(10); // short pause to avoid 100% CPU usage
  } while (now < 100000 && (millis() - tstart) < 10000); // timeout ex. 10s

  // time_t now = time(nullptr);
  struct tm tmNow;
  localtime_r(&now, &tmNow);
  int month = tmNow.tm_mon + 1;

  if (strcmp(DST_REGION, "EU") == 0) {
    if (month > 3 && month < 10) dstOffset = 3600;
  } else if (strcmp(DST_REGION, "US") == 0) {
    if (month > 3 && month < 11) dstOffset = 3600;
  }

  configTime(offsetSeconds + dstOffset, 0, "pool.ntp.org", "time.nist.gov");
}

void blinkLED() {
  digitalWrite(LED_PIN, LOW);   // turn on LED
  delay(100);
  digitalWrite(LED_PIN, HIGH);  // turn off LED
}

  // draws the start frame at the center of the screen
void drawStartupFrame() {
  unsigned long now = millis();
  if (now - startupLastMs >= STARTUP_FRAME_DELAY) {
    startupLastMs = now;
    startupFrameIdx = (startupFrameIdx + 1) % STARTUP_FRAME_COUNT;
  }

  display.clearDisplay();

  // centering 48x48 on 128x64
  int x = (SCREEN_WIDTH - STARTUP_W) / 2;   // = 40
  int y = (SCREEN_HEIGHT - STARTUP_H) / 2;  // = 8

  display.drawBitmap(x, y, frames_startup[startupFrameIdx], STARTUP_W, STARTUP_H, SSD1306_WHITE);
  display.display();
}

// --- Function fetching data from the API ---
void fetchStats() {
  WiFiClientSecure client;
  client.setInsecure();
  HTTPClient http;

  if (http.begin(client, apiURL)) {
    int httpCode = http.GET();
    if (httpCode == HTTP_CODE_OK) {
      String payload = http.getString();
      Serial.println(payload);

      // --- Merge JSON into an array ---
      String json1, json2, json3;
      int firstNL = payload.indexOf('\n');
      int secondNL = payload.indexOf('\n', firstNL + 1);
      if (firstNL > 0 && secondNL > 0) {
        json1 = payload.substring(0, firstNL);
        json2 = payload.substring(firstNL + 1, secondNL);
        json3 = payload.substring(secondNL + 1);
      }
      String jsonArray = "[" + json1 + "," + json2 + "," + json3 + "]";

      // --- Parsing ---
      StaticJsonDocument<4096> doc;
      DeserializationError error = deserializeJson(doc, jsonArray);
      if (error) {
        Serial.print("Błąd JSON: ");
        Serial.println(error.c_str());
        http.end();
        return;
      }

      // --- Data from all 3 objects ---
      usersCount = doc[0]["Users"] | 0;
      workersCount = doc[0]["Workers"] | 0;
      idleCount = doc[0]["Idle"] | 0;
      disconnectedCount = doc[0]["Disconnected"] | 0;

      hashrate1m = doc[1]["hashrate1m"].as<String>();
      hashrate5m = doc[1]["hashrate5m"].as<String>();
      hashrate15m = doc[1]["hashrate15m"].as<String>();
      hashrate1hr = doc[1]["hashrate1hr"].as<String>();
      hashrate6hr = doc[1]["hashrate6hr"].as<String>();
      hashrate1d = doc[1]["hashrate1d"].as<String>();
      hashrate7d = doc[1]["hashrate7d"].as<String>();

      diff = doc[2]["diff"] | 0.0;
      accepted = doc[2]["accepted"] | 0.0;
      rejected = doc[2]["rejected"] | 0.0;
      bestshare = doc[2]["bestshare"] | 0.0;
      SPS1m = doc[2]["SPS1m"] | 0.0;
      SPS5m = doc[2]["SPS5m"] | 0.0;
      SPS15m = doc[2]["SPS15m"] | 0.0;
      SPS1h = doc[2]["SPS1h"] | 0.0;
    }
    http.end();
  }
}

void fetchUserStats() {
  WiFiClientSecure client;
  client.setInsecure();
  HTTPClient http;

  if (http.begin(client, userApiURL)) {
    int httpCode = http.GET();
    if (httpCode == HTTP_CODE_OK) {
      String payload = http.getString();
      Serial.println(payload);

      StaticJsonDocument<4096> doc;
      DeserializationError error = deserializeJson(doc, payload);
      if (error) {
        Serial.print("Błąd JSON user: ");
        Serial.println(error.c_str());
        http.end();
        return;
      }

      u_hashrate1m = doc["hashrate1m"].as<String>();
      u_hashrate5m = doc["hashrate5m"].as<String>();
      u_hashrate1hr = doc["hashrate1hr"].as<String>();
      u_hashrate1d = doc["hashrate1d"].as<String>();
      u_hashrate7d = doc["hashrate7d"].as<String>();
      u_lastshare  = doc["lastshare"] | 0;
      u_workers    = doc["workers"] | 0;
      u_shares     = doc["shares"] | 0.0;
      u_bestshare  = doc["bestshare"] | 0.0;
      u_bestever   = doc["bestever"] | 0.0;
      u_authorised = doc["authorised"] | 0;
    }
    http.end();
  }
}

// --- Function drawing pages ---
void drawPage(int page) {
  display.clearDisplay();
  display.setTextSize(1);
  display.setTextColor(SSD1306_WHITE);

  char buf[20];
  time_t t = time(nullptr);
  struct tm timeinfo;
  localtime_r(&t, &timeinfo);

  if (page == 0) {

    display.setTextSize(2);
    display.setFont(&Org_01);
    display.setCursor(21, 12);
    display.println("NerdMiner");
    display.drawLine(0, 21, SCREEN_WIDTH, 21, SSD1306_WHITE);
    display.drawBitmap(5, 30, frames_clock[animFrameIdx0], CLOCK_W, CLOCK_H, SSD1306_WHITE);

    strftime(buf, sizeof(buf), "%H:%M", &timeinfo);
    display.setCursor(52, 55);
    display.setTextSize(2);
    display.println(buf);

    strftime(buf, sizeof(buf), "%d-%m-%Y", &timeinfo);
    display.setTextSize(1);
    display.setCursor(52, 39);
    display.println(buf);

  } else if (page == 1) {

    display.setTextSize(2);
    display.setFont(&Org_01);
    display.setCursor(0, 11);
    display.setTextWrap(0);
    display.setCursor(21, 11);
    display.println("NerdMiner");
    display.drawRect(0, 22, 128, 42, 1);
    display.setTextSize(1);
    display.setCursor(0, 30);
    display.setTextWrap(0);
    display.setCursor(24, 33);
    display.println("YOUR HASHRATE:");
    display.setTextSize(2);
    display.setTextWrap(0);
    display.setCursor(22, 50);
    display.println(splitNumberUnit(u_hashrate1m) + "H/s");

  } else if (page == 2) {

    display.setTextSize(2);
    display.setFont(&Org_01);
    display.setCursor(0, 11);
    display.setTextWrap(0);
    display.setCursor(13, 11);
    display.println("Pool Stats");
    display.drawRect(0, 22, 128, 42, 1);
    display.setTextSize(1);
    display.setCursor(0, 34);
    display.setTextSize(1);
    display.drawBitmap(5, 27, frames_pool[animFrameIdx0], POOL_W, POOL_H, SSD1306_WHITE);
    display.setCursor(45, 35);
    display.println("USERS: " + String(usersCount));
    display.setCursor(45, 45);
    display.println("WORKERS: " + String(workersCount));
    display.setCursor(45, 55);
    display.println("--> " + splitNumberUnit(hashrate1m) + "H/s");

  } else if (page == 3) {

    display.setTextSize(2);
    display.setFont(&Org_01);
    display.setCursor(0, 11);
    display.setTextWrap(0);
    display.setCursor(10, 11);
    display.println("Your Stats");
    display.drawRect(0, 22, 128, 42, 1);
    display.setTextSize(1);
    display.setCursor(0, 34);
    display.setTextSize(1);
    display.drawBitmap(5, 27, frames_user[animFrameIdx0], USER_W, USER_H, SSD1306_WHITE);
    display.setCursor(45, 35);
    display.println("WORKERS: " + String(u_workers));
    display.setCursor(45, 45);
    display.println("SHARES: " + String(u_shares, 0));
    display.setCursor(45, 55);
    display.println("BEST: " + String(u_bestshare, 2));

  }
  display.display();
}

// --- Setup ---
void setup() {
  Serial.begin(115200);

  // --- OLED ---
  Wire.begin(OLED_SDA, OLED_SCL);
  if (!display.begin(SSD1306_SWITCHCAPVCC, 0x3C)) {
    Serial.println(F("SSD1306 allocation failed"));
    for (;;);
  }
  display.clearDisplay();
  display.display();

  // --- LED ---
  pinMode(LED_PIN, OUTPUT);
  digitalWrite(LED_PIN, HIGH); // disabled at startup

  // --- WiFi ---
  WiFi.begin(WIFI_SSID, WIFI_PASS);

  // animate until connected (without blocking delay)
  Serial.print("Connecting to WiFi");
  while (WiFi.status() != WL_CONNECTED) {
    // animate frames
    drawStartupFrame();

    // print dots every 500ms (non-blocking)
    static unsigned long dotLast = 0;
    if (millis() - dotLast >= 500) {
      Serial.print(".");
      dotLast = millis();
    }

    // allow WiFi threads to run
    yield();
  }
  Serial.println("\nWiFi connected");

  setupTime();
  fetchStats();
  fetchUserStats();
  blinkLED();

}

// --- Loop ---
void loop() {
  unsigned long now = millis();
  if (now - lastSwitch > pageInterval) {
    lastSwitch = now;
    currentPage++;
    if (currentPage > 3) currentPage = 0;
    drawPage(currentPage);
  }

    // refreshing animations every ~42ms
  static unsigned long lastDraw = 0;
  if (now - lastDraw >= 42) {
    lastDraw = now;

    if (currentPage == 0) {
      if (now - animLastMillis0 >= CLOCK_FRAME_DELAY) {
        animLastMillis0 = now;
        animFrameIdx0 = (animFrameIdx0 + 1) % CLOCK_FRAME_COUNT;
      }
    }
    if (currentPage == 2) {
      if (now - animLastMillis0 >= POOL_FRAME_DELAY) {
        animLastMillis0 = now;
        animFrameIdx0 = (animFrameIdx0 + 1) % POOL_FRAME_COUNT;
      }
    }
    if (currentPage == 3) {
      if (now - animLastMillis0 >= USER_FRAME_DELAY) {
        animLastMillis0 = now;
        animFrameIdx0 = (animFrameIdx0 + 1) % USER_FRAME_COUNT;
      }
    }

    // draw the current page (drawPage uses animFrameIdx0)
    drawPage(currentPage);
  }

  static unsigned long lastFetch = 0;
  if (millis() - lastFetch > 60000) { // refreshing every minute
    lastFetch = millis();
    fetchStats();
    fetchUserStats();
    blinkLED();
  }
}